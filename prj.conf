## CMakeLists.txt
```
# SPDX-License-Identifier: Apache-2.0
# Copyright (c) 2026 Tim Alexeenko
# E-mail: <cloclacordis@proton.me>

cmake_minimum_required(VERSION 3.28.0)
find_package(Zephyr REQUIRED HINTS $ENV{ZEPHYR_BASE})
project(evapotranspiration_firmware)

set(EVAPOCORE_DIR
    ${CMAKE_CURRENT_SOURCE_DIR}/evapocore
)

# Portable EvapoCore modules
file(GLOB_RECURSE EVAPOCORE_SOURCES CONFIGURE_DEPENDS
    "${EVAPOCORE_DIR}/01-measurement/*.c"
    "${EVAPOCORE_DIR}/02-providers/*.c"
    "${EVAPOCORE_DIR}/03-validation/*.c"
    "${EVAPOCORE_DIR}/04-calculation/*.c"
)

# Replace the host time source with the Zephyr platform adapter
list(REMOVE_ITEM EVAPOCORE_SOURCES
    "${EVAPOCORE_DIR}/02-providers/023-time/time-provider-host.c"
)

# Existing orchestration: keep the calculation/application logic unchanged
list(APPEND EVAPOCORE_SOURCES
    "${EVAPOCORE_DIR}/05-orchestration/daily-cycle.c"
)

set(PLATFORM_SOURCES
    platform/zephyr/src/time/rtc-service.c
    platform/zephyr/src/time/time-provider-zephyr.c
    platform/zephyr/src/console/service-console.c
)

target_sources(app PRIVATE
    src/main.c
    ${EVAPOCORE_SOURCES}
    ${PLATFORM_SOURCES}
)

target_include_directories(app PRIVATE
    "${EVAPOCORE_DIR}"
    "${CMAKE_CURRENT_SOURCE_DIR}/platform/zephyr/include"
)

target_link_libraries(app PRIVATE m)
```

## west.yml
```
manifest:
  remotes:
    - name: zephyrproject-rtos
      url-base: https://github.com/zephyrproject-rtos

  projects:
    - name: zephyr
      remote: zephyrproject-rtos
      revision: v4.5.0
      import: true

  self:
    path: applications/evapotranspiration-firmware
```

## prj.conf
```kconfig
# Console output
CONFIG_PRINTK=y
CONFIG_SERIAL=y
CONFIG_CONSOLE=y
CONFIG_UART_CONSOLE=y
CONFIG_STDOUT_CONSOLE=y

# Interrupt-driven UART RX for service-console.c
CONFIG_UART_INTERRUPT_DRIVEN=y

# EvapoCore PrintReport() uses floating-point printf formats such as %.4f
CONFIG_PICOLIBC=y
CONFIG_PICOLIBC_IO_FLOAT=y

# RTC and STM32 backup registers
CONFIG_RTC=y
CONFIG_BBRAM=y

# Status LED
CONFIG_GPIO=y

# Keep SWD debugging available while Zephyr enters idle/sleep
CONFIG_STM32_ENABLE_DEBUG_SLEEP_STOP=y

# Give the main thread adequate stack for formatted reports and libc calls
CONFIG_MAIN_STACK_SIZE=2048
```

## app.overlay
```dts
#include <zephyr/dt-bindings/clock/stm32f4_clock.h>

/* External 32.768 kHz crystal */
&clk_lse {
    status = "okay";
};

/* RTC clock configuration */
&rtc {
    clocks = <&rcc STM32_CLOCK(APB1, 28)>,
             <&rcc STM32_SRC_LSE RTC_SEL(1)>;

    async-prescaler = <127>;
    sync-prescaler  = <255>;

    status = "okay";
};

/* RTC backup registers */
&bbram {
    status = "okay";
};
```

## src/main.c
```c
/* SPDX-License-Identifier: Apache-2.0
 * Copyright (c) 2026 Tim Alexeenko
 * E-mail: <cloclacordis@proton.me> */

#include <stdbool.h>
#include <stdint.h>
#include <stdio.h>

#include <zephyr/devicetree.h>
#include <zephyr/drivers/gpio.h>
#include <zephyr/sys/time_units.h>
#include <zephyr/kernel.h>

#include "03-validation/033-status/status.h"
#include "05-orchestration/daily-cycle.h"

#include "service-console.h"
#include "rtc-service.h"

#define STATUS_LED_NODE DT_ALIAS(led0)

#if !DT_NODE_HAS_STATUS(STATUS_LED_NODE, okay)
#error "The selected board must provide the led0 Devicetree alias"
#endif

static const struct gpio_dt_spec s_status_led = GPIO_DT_SPEC_GET(STATUS_LED_NODE, gpios);
static bool s_status_led_ready;

static void StatusLed_Init(void) {
    if (!gpio_is_ready_dt(&s_status_led)) {
        (void)printf("WARNING: status LED GPIO controller is not ready.\n");
        s_status_led_ready = false;
        return;
    }

    const int ret = gpio_pin_configure_dt(&s_status_led, GPIO_OUTPUT_INACTIVE);

    if (ret < 0) {
        (void)printf("WARNING: status LED configuration failed: %d\n", ret);
        s_status_led_ready = false;
        return;
    }

    s_status_led_ready = true;
}

static void StatusLed_Set(const bool active) {
    if (!s_status_led_ready) {
        return;
    }

    const int ret = gpio_pin_set_dt(&s_status_led, active ? 1 : 0);

    if (ret < 0) {
        (void)printf("WARNING: status LED update failed: %d\n", ret);
        s_status_led_ready = false;
    }
}

static void ExecuteDailyCycle(DailyResults *results) {
    const RTCState rtc_state = RTC_GetState();

    if (rtc_state != RTC_STATE_TRUSTED) {
        (void)printf(
            "\nCalculation not started: RTC state is %s.\n"
            "Set/verify UTC time first.\n",
            RTCState_ToString(rtc_state));
        return;
    }

    (void)printf("\nRUN accepted, starting RunDailyCycle...\n");

    const char *failed_step = "unknown";
    StatusLed_Set(true);

    const uint32_t cycles_start = k_cycle_get_32();
    const Status status = RunDailyCycle(results, &failed_step);
    const uint32_t cycles_elapsed = k_cycle_get_32() - cycles_start;

    StatusLed_Set(false);

    const uint64_t elapsed_us =
        k_cyc_to_us_floor64((uint64_t)cycles_elapsed);

    (void)printf(
        "\nRunDailyCycle: %s (%lu cycles, %lu.%03lu ms)\n", Status_ToString(status),
        (unsigned long)cycles_elapsed, (unsigned long)(elapsed_us / 1000U),
        (unsigned long)(elapsed_us % 1000U));

    /* Print the clock and station date after the calculation, as in v01x */
    Console_PrintCurrentTime();

    if (status != STATUS_OK) {
        (void)fprintf(stderr,
                      "\nRunDailyCycle failed at %s: %s.\n", failed_step, Status_ToString(status));
        return;
    }

    (void)printf(
        "\nRunDailyCycle OK\n"
        "Station date used by calculation: %04u-%02u-%02u\n\n",
        (unsigned)results->date.year, (unsigned)results->date.month, (unsigned)results->date.day);

    PrintReport(results);
}

int main(void) {
    (void)printf("\nEvapotranspiration Firmware | ZEPHYR 4.5 | STM32F446RE\n");

    StatusLed_Init();

    const Status rtc_status = RTC_Init();
    (void)printf("\nRTC init: %s\n", Status_ToString(rtc_status));

    Console_Init();

    static DailyResults results;

    for (;;) {
        if (Console_Poll()) {
            ExecuteDailyCycle(&results);
        } else {
            /* RX is interrupt-driven, so sleeping does not lose UART bytes */
            k_sleep(K_MSEC(10));
        }
    }

    return 0;
}
```
